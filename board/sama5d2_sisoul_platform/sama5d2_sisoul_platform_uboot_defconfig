## board/sama5d2_sisoul_platform/sama5d2_sisoul_platform_uboot_defconfig
```kconfig
CONFIG_SAMA5D2_SISOUL_PLATFORM=y
CONFIG_RAM_256MB=y
CONFIG_DDR3=y
CONFIG_DEBUG=y
# CONFIG_ENTER_NWD is not set
CONFIG_ACT8865_SET_VOLTAGE=y
# CONFIG_DISABLE_ACT8865_I2C is not set
```
